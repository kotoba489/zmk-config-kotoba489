## config/boards/shields/k_grid/Kconfig.defconfig
```kconfig
if SHIELD_K_GRID_LEFT || SHIELD_K_GRID_RIGHT

config ZMK_KEYBOARD_NAME
    default "k_grid"

endif
```

## config/boards/shields/totem/Kconfig.defconfig
```kconfig
if SHIELD_TOTEM_LEFT || SHIELD_TOTEM_RIGHT

config ZMK_KEYBOARD_NAME
    default "TOTEM"

endif
```

## config/boards/shields/totem/Kconfig.shield
```kconfig
config SHIELD_TOTEM_LEFT
    def_bool $(shields_list_contains,totem_left)

config SHIELD_TOTEM_RIGHT
    def_bool $(shields_list_contains,totem_right)

# ここに「格子状」であることを暗示するダミーの定義を入れます
config SHIELD_TOTEM_GRID
    def_bool y
```
